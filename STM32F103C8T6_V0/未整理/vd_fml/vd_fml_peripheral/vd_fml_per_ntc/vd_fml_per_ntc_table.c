/*
 * Project: WH001
 * Module: 
 * File: ntc_table.c
 * Created Date: 2022-11-25 16:57:55
 * Author: your_name
 * Description: description
 * -----
 * todo: modified 
 * -----
 * Copyright (c) 2022 - vDiscovery, Inc
 */

/* ======================================================================================
 * log
 */
#define LOG_ENABLE_DEBUG (1)

/* ======================================================================================
 * includes
 */
#include "ntc_table.h"

/* ======================================================================================
 * macros
 */
const unsigned int ntc_table[NUM] ={//温度和adc对应表
    17,	    18,	    19,	    21,	    22,	    23,	    24,	    26,	    27,	    29,	    //-50~ -41	     
    31,	    32,	    34,	    36,	    39,	    41,	    44,	    47,	    50,	    53,	    //-40~ -31
    56,	    59,	    63,	    66,	    70,	    74,	    78,	    83,	    87,	    92,	    //-50~ -21	
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    1017,

};

/* ======================================================================================
 * types
 */

/* ======================================================================================
 * declaration
 */

/* ======================================================================================
 * globals
 */

/* ======================================================================================
 * helper
 */

/* ======================================================================================
 * private implementation
 */

/**
 * @brief adc转换成温度
 * 
 * @param r_adc 
 * @return float 
 */
vd_int_t read_ntc_temperature(unsigned int r_adc)
{
	vd_int32_t middle; //存每次的中间点
	vd_int32_t right; //终点
	vd_int32_t left; //起点
	vd_float_t k, j, fraction;
	right = (sizeof(ntc_table) / sizeof(ntc_table[0]) - 1);
	// co_printf("right = %d\n",right);
	left = 0;
	middle = (right - left) / 2;
	// co_printf("middle = %d\n",middle);
	while(1)
	{
	    // co_printf("r_adc=%d\n",r_adc);
		if(r_adc > ntc_table[middle])
		{
			if(r_adc <= ntc_table[middle + 1]) //找到了
			{
				k = ntc_table[middle + 1] - ntc_table[middle];
				j = r_adc - ntc_table[middle];
				fraction = j / k;
                // co_printf("1\n");
				return (middle - 72 + fraction);
                
			}
			else //没找到
			{
				left = middle;
                // co_printf("2\n");
			}
		}
		else if(r_adc < ntc_table[middle])
		{	
			if(r_adc >= ntc_table[middle - 1]) //找到了
			{
				k = ntc_table[middle] - ntc_table[middle - 1];
				j = r_adc - ntc_table[middle - 1];
				fraction = j / k;
                // co_printf("3\n");
				return (middle - 73 + fraction);
			}
			else //没找到
			{
				if(r_adc < 17)
				{
                    // co_printf("4\n");
					return 0;
				}
				else
					right = middle;
			}
		}
		else if(r_adc == ntc_table[middle]) //找到了
		{
            // co_printf("5\n");
			return (middle - 72);
		}
		middle = (right - left) / 2;
		middle = left + middle; //相当重要，光除2不是中间点，加上起点之后才是中间点
	}	
}
/* ======================================================================================
 * implementation
 */
